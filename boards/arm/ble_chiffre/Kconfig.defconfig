## boards/arm/ble_chiffre/Kconfig.defconfig
```kconfig
# Copyright (c) 2020 Pete Johanson, TJ Campie
# SPDX-License-Identifier: MIT

if BOARD_BLE_CHIFFRE

config ZMK_KEYBOARD_NAME
    default "BLe Chiffre"

config BT_CTLR
    default BT

if ZMK_DISPLAY

config I2C
    default y

config SSD1306
    default y

endif # ZMK_DISPLAY

endif # BOARD_BLE_CHIFFRE
```

## config/boards/arm/ble_chiffre/Kconfig.board
```kconfig
# Copyright (c) 2020 The ZMK Contributors
# SPDX-License-Identifier: MIT

config BOARD_BLE_CHIFFRE
   bool "BLe Chiffre"
   depends on SOC_NRF52840_QIAA
```

## config/west.yml
```yaml
manifest:
  remotes:
    - name: zmkfirmware
      url-base: https://github.com/zmkfirmware
    - name: tominabox1
      url-base: https://github.com/tominabox1/
    - name: nicell
      url-base: https://github.com/Nicell/
    - name: okke
      url-base: https://github.com/okke-formsma
    - name: pete
      url-base: https://github.com/petejohanson/
    - name: ftc
      url-base: https://github.com/ftc
  projects:
    - name: zmk
      remote: ftc
      revision: mouse-ftc
      import: app/west.yml
  self:
    path: config
```
